/ {
    compatible = "zmk,keyboard-shield";

    matrix {
        rows = < &gpio0 29 &gpio0 2 &gpio0 115 >;
        cols = < &gpio0 20 &gpio0 22 &gpio0 24 &gpio0 100 &gpio0 11 &gpio0 104 >;
    };

    
};
