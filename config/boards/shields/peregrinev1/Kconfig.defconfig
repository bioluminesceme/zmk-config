## config/boards/shields/peregrinev1/Kconfig.defconfig
```kconfig
# Copyright (c) 2022 The ZMK Contributors
# SPDX-License-Identifier: MIT

if SHIELD_PEREGRINE_LEFT

config ZMK_KEYBOARD_NAME
    default "Peregrine"

config ZMK_SPLIT_ROLE_CENTRAL
    default y

endif # SHIELD_PEREGRINE_LEFT

if SHIELD_PEREGRINE_LEFT || SHIELD_PEREGRINE_RIGHT

config ZMK_SPLIT
    default y
  
endif # SHIELD_PEREGRINE_LEFT || SHIELD_PEREGRINE_RIGHT
```

## config/boards/shields/peregrinev1/Kconfig.shield
```kconfig
# Copyright (c) 2022 The ZMK Contributors
# SPDX-License-Identifier: MIT

config SHIELD_PEREGRINEV1_LEFT
    def_bool $(shields_list_contains,peregrinev1_left)

config SHIELD_PEREGRINEV1_RIGHT
    def_bool $(shields_list_contains,peregrinev1_right)
```
