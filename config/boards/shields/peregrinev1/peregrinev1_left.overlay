/ {
    compatible = "zmk,keyboard-shield";

    matrix {
        // if the pin number starts with 0 it's gpio 0.
        // so  &gpio1 4 = P1.04 = pin labeled "104"
        rows = < &gpio0 29 &gpio0 2 &gpio0 115 >;
        cols = < &gpio0 20 &gpio0 22 &gpio0 24 &gpio0 100 &gpio0 11 &gpio1 4 >;
        
    };

};
